## beepberry_os/bcm2708-rpi-zero-w/external/Config.in
```kconfig
source "$BR2_EXTERNAL_BEEPBERRY_PATH/package/sharp/Config.in"
source "$BR2_EXTERNAL_BEEPBERRY_PATH/package/bbqX0kbd/Config.in"
```

## beepberry_os/bcm2708-rpi-zero-w/external/package/bbqX0kbd/Config.in
```kconfig
config BR2_PACKAGE_BBQX0KBD
    bool "bbqx0kbd"
    help
        BBQX0 Keyboard Driver for Linux
```

## beepberry_os/bcm2708-rpi-zero-w/external/package/sharp/Config.in
```kconfig
config BR2_PACKAGE_SHARP
    bool "sharp"
    help
        Sharp Memory LCD Kernel Driver
```
